## firmware/native/main/Kconfig.projbuild
```kconfig
menu "Clock Connection Configuration"
    config CLOCK_WIFI_SSID
        string "Wi-Fi SSID"
    config CLOCK_WIFI_PASSWORD
        string "Wi-Fi password"
    config CLOCK_MQTT_BROKER
        string "MQTT Broker URL"
        default "mqtt://test.mosquitto.org"
    config CLOCK_MQTT_USERNAME
        string "MQTT Username"
    config CLOCK_MQTT_PASSWORD
        string "MQTT Password"
endmenu
```
